&soc {
	gpio-leds {
		compatible = "gpio-leds-ir";
		status = "okay";
		pinctrl-names = "default";
		pinctrl-0 = <&gpio_led_off>;
		infred {
			gpios = <&tlmm 45 0>;
			label = "infrared";
			linux,default-trigger = "infra-red";
			default-state = "off";
			retain-state-suspended;
		};
	};
};

&usb_otg {
	vbus_otg-supply = <&smb358_otg_vreg>;
	extcon = <&smb358_otg_vreg>;
	qcom,hsusb-otg-phy-init-seq =
		<0x39 0x81 0x37 0x82 0xffffffff>;
};
