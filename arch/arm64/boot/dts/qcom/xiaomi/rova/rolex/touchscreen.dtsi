&i2c_3 {
        qcom,clk-freq-out = <100000>;
	goodix_ts@5d {
		vcc_i2c-supply = <&pm8937_l6>;
            goodix,cfg-group0 = [
            52 D0 02 00 05 0A 3C CF 11 CF 32
            0F 5A 46 05 64 00 00 00 00 24 33
            00 14 16 28 14 87 27 CD 40 42 B8
            08 0F 0A 00 5A 33 91 00 00 00 00
            00 C4 C4 32 C8 00 31 1E 50 82 E0
            E4 0F 28 19 04 E2 21 00 97 28 00
            89 2E 00 80 3B 00 70 48 00 6E 10
            38 68 00 57 55 40 66 6F 17 3C 02
            02 00 00 00 00 00 00 02 00 00 0F
            28 00 00 00 00 00 0A 5A 00 00 00
            00 46 00 07 08 09 0A 0B 0C 0D 0E
            0F 10 11 18 17 16 15 14 13 06 05
            04 03 02 01 12 FF FF FF FF FF 29
            28 24 22 20 1F 1E 0A 08 06 05 04
            02 00 FF FF FF 00 00 00 00 00 00
            00 00 00 32 41 41 00 23 28 86 00
            00 00 00 00 00 00 0F 46 00 00 00
            00 00 00 28 4B 00 00 00 00 00 00
            00 01 01 14 78 1D 23 1E 3E 1E 01
            01 14 50 00 05 00 00 00 00 00 00
            00 00 00 00 00 00 EC 01
            ];
	};
};
