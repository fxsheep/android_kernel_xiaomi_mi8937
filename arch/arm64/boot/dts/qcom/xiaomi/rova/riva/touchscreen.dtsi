&i2c_3 {
	goodix_ts@5d {
		vcc_i2c-supply = <&pm8937_l5>;
			goodix,cfg-group0 = [
					41 D0 02 00 05 05 75 01 01 0F 24
					0F 64 3C 03 05 00 00 00 02 00 00
					00 16 19 1C 14 8C 0E 0E 24 00 31
					0D 00 00 00 83 33 1D 00 41 00 00
					00 00 00 08 0A 00 2B 1C 3C 94 D5
					03 08 00 00 04 93 1E 00 82 23 00
					74 29 00 69 2F 00 5F 37 00 5F 20
					40 60 00 F0 40 30 55 50 27 00 00
					00 00 00 00 00 00 00 00 00 00 00
					00 00 00 00 00 00 00 14 19 00 00
					50 50 02 04 06 08 0A 0C 0E 10 12
					14 16 18 1A 1C 00 00 00 00 00 00
					00 00 00 00 00 00 00 00 00 00 1D
					1E 1F 20 21 22 24 26 28 29 2A 1C
					18 16 14 13 12 10 0F 0C 0A 08 06
					04 02 00 00 00 00 00 00 00 00 00
					00 00 00 00 00 00 00 00 9C 01];
	};
};
