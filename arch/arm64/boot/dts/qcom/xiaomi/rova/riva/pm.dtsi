/*
 * Copyright (c) 2015-2016, 2018, The Linux Foundation. All rights reserved.
 *
 * This program is free software; you can redistribute it and/or modify
 * it under the terms of the GNU General Public License version 2 and
 * only version 2 as published by the Free Software Foundation.
 *
 * This program is distributed in the hope that it will be useful,
 * but WITHOUT ANY WARRANTY; without even the implied warranty of
 * MERCHANTABILITY or FITNESS FOR A PARTICULAR PURPOSE.  See the
 * GNU General Public License for more details.
 */

&pm8937_1{
        pm8937_pwm: pwm@bc00 {
                status = "ok";
                compatible = "qcom,qpnp-pwm";
                reg = <0xbc00 0x100>;
                reg-names = "qpnp-lpg-channel-base";
                qcom,channel-id = <0>;
                qcom,supported-sizes = <6>, <9>;
                qcom,force-pwm-size = <9>;
                #pwm-cells = <2>;
        };
};
